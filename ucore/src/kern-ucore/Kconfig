## ucore/src/kern-ucore/Kconfig
```kconfig
menu "Toolchain setup"

config CROSS_COMPILE
  string "Cross-compiler tool prefix"

config ADDITIONAL_CFLAGS
  string "Additional CFLAGS"

config ADDITIONAL_LDFLAGS
  string "Additional LDFLAGS"

config BIONIC_LIBC
  bool "Enable bionic C library related-code"
  default n
  help
    When selected, this option enable bionic C related code. Note that currently
    only amd64 and ARM architecture is supported. Enabling this on other
    architectures triggers compiling error.

endmenu
```

## ucore/src/kern-ucore/arch/mips/Kconfig
```kconfig
source src/kern-ucore/Kconfig
source src/kern-ucore/numa/Kconfig
source src/kern-ucore/mm/Kconfig
source src/kern-ucore/schedule/Kconfig
source src/kern-ucore/fs/Kconfig
source src/kern-ucore/module/Kconfig

config MIPS_USE_THINPAD_SERIAL_DRIVER
  bool "Enable Thinpad Serial Driver"
  default n
  help
    In most cases, The FPGA-based processor in Thinpad is much simplier than
    and incompatible with the one qemu simulated. Enabling this option to
    use that simple serial driver. Note you may need to modify the source code
    if your serial implementation is different (e.g. having different I/O map).

config MIPS_ENABLE_THINPAD_FLASH_DRIVER
  bool "Enable Simple (i.e. Thinpad) Serial Driver"
  default n
  help
    Enabling this option to enable access to FlashROM through FPGA-based
    processor in Thinpad. Note you may need to modify the source code
    if your serial implementation is different (e.g. having different I/O map).
```

## ucore/src/kern-ucore/fs/Kconfig
```kconfig
menu Filesystem

config HAVE_SFS
  bool "Enable Simple Filesystem(SFS)"
  default y

config SFS_IMAGE_SIZE
  depends HAVE_SFS
  int  "SFS Image size"
  default 4

config SFS_MINIMAL_CONTENT
  depends HAVE_SFS
  bool "Minimize contents"
  default n
  help
    When selected, this option will exclude most useless files in the
    sfs img to make it fit for embedded systems.

config HAVE_YAFFS2
  bool "Enable YAFFS2"
  default n

config HAVE_YAFFS2_RAMDISK
  depends HAVE_YAFFS2
  bool "Enable YAFFS2 Ramdisk (for debugging)"
  default n

config HAVE_FATFS
  bool "Enable Fat32"
  default n

config HAVE_FUSE
  bool "Enable FUSE (Under development, not usable yet.)"
  help
    When selected, this option will enable FUSE (Filesystem in USErspace),
    However, this is a porting project from FreeBSD, and is not finished yet.
    So enable it only when you are working on it.
  default n

endmenu
```
